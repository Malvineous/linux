## arch/arm/mach-nuc700/Kconfig
```kconfig
if ARCH_NUC700

config CPU_NUC710
	bool
	help
	  Support for NUC710 of Nuvoton NUC700 CPUs.

config CPU_NUC740
	bool
	help
	  Support for NUC740 of Nuvoton NUC700 CPUs.

config CPU_NUC745
	bool
	help
	  Support for NUC745 of Nuvoton NUC700 CPUs.

menu "NUC700 boards"

config MACH_NUC710EVB
	bool "Nuvoton NUC710 evaluation board"
	default y
	select CPU_NUC710
	select PLAT_NUVOTON
	help
	  Say Y here if you are using the Nuvoton NUC710EVB, or a similar board
	  based on the NUC710 CPU.

config MACH_NUC740EVB
	bool "Nuvoton NUC740 evaluation board"
	select CPU_NUC740
	select PLAT_NUVOTON
	help
	  Say Y here if you are using the Nuvoton NUC740EVB, or a similar board
	  based on the NUC740 CPU.

config MACH_NUC745EVB
	bool "Nuvoton NUC745 evaluation board"
	select CPU_NUC745
	select PLAT_NUVOTON
	help
	  Say Y here if you are using the Nuvoton NUC745EVB, or a similar board
	  based on the NUC745 CPU.

endmenu

menu "NUC700 UART configuration"

comment "UART0 is always enabled"

config NUC700_UART1
	bool "Enable UART1"
	default n
	depends on MACH_NUC710EVB || MACH_NUC740EVB || MACH_NUC745EVB
	help
	  Say Y here if you are using the Nuvoton NUC700EVB.

config NUC700_UART1_CTSRTS
	bool "Enable CTS/RTS on UART1 / Disable UART2"
	default n
	depends on NUC700_UART1
	help
	  Say Y here if you are not using UART2, and wish to use some of those
	  pins as CTS/RTS signals on UART1 instead.

config NUC700_UART2
	bool "Enable UART2"
	default n
	depends on (MACH_NUC710EVB || MACH_NUC740EVB || MACH_NUC745EVB) && (!NUC700_UART1_CTSRTS)
	help
	  Say Y here if you are using the Nuvoton NUC700EVB.

config NUC700_UART3
	bool "Enable UART3 / Disable AC97"
	default n
	depends on MACH_NUC710EVB || MACH_NUC740EVB || MACH_NUC745EVB
	help
	  Say Y here if you are not using AC97 audio, and wish to use some of
	  those pins as UART3 instead.

endmenu

endif
```

## arch/arm/plat-nuvoton/Kconfig
```kconfig
#
# Winbond/Nuvoton Platform configuration file
#

if PLAT_NUVOTON

config NUVOTON_USE_WBL
	bool "Nuvoton / Winbond bootloader support"
	default y
	help
	  If your platform runs the Winbond/Nuvoton WBL bootloader, enabling
	  this option will use the data set in the bootloader, such as
	  the board's MAC address.

	  It will also make each flash image (as shown in the bootloader)
	  appear as a separate MTD partition, if MTD support is enabled.
	  This will allow you to flash images through the bootloader and have
	  them appear as corresponding /dev/mtdblockX block devices.

	  Say N here if your board uses a different bootloader.

endif
```

## drivers/net/ethernet/nuvoton/Kconfig
```kconfig
#
# Nuvoton network device configuration
#

config NET_VENDOR_NUVOTON
	bool "Nuvoton devices"
	default y
	depends on ARM && (ARCH_NUC700 || ARCH_W90X900)
	---help---
	  If you have a network (Ethernet) card belonging to this class, say Y
	  and read the Ethernet-HOWTO, available from
	  <http://www.tldp.org/docs.html#howto>.

	  Note that the answer to this question doesn't directly affect the
	  kernel: saying N will just cause the configurator to skip all
	  the questions about Nuvoton cards. If you say Y, you will be asked
	  for your specific card in the following questions.

if NET_VENDOR_NUVOTON

config W90P910_ETH
	tristate "Nuvoton NUC700/NUC900 Ethernet support"
	depends on ARM && (ARCH_NUC700 || ARCH_W90X900)
	select PHYLIB
	select NET_CORE
	select MII
	---help---
	  Say Y here if you want to use the built-in Ethernet ports
	  on the NUC700/NUC900/W90P910 series of processors.

endif # NET_VENDOR_NUVOTON
```

## sound/soc/nuc900/Kconfig
```kconfig
##
## NUC700/NUC900 series AC97 API
##
config SND_SOC_NUC900
	tristate "SoC Audio for NUC700/NUC900 series"
	depends on ARCH_NUC700 || ARCH_W90X900
	help
	  This option enables support for AC97 mode on the NUC700 and NUC900
	  SoC.

config SND_SOC_NUC900_AC97
	tristate
	select AC97_BUS
	select SND_AC97_CODEC
	select SND_SOC_AC97_BUS


##
## Boards
##
config SND_SOC_NUC900EVB
	tristate "AC97 support for NUC700/NUC900 demo board"
	depends on SND_SOC_NUC900
	select SND_SOC_NUC900_AC97
	select SND_SOC_AC97_CODEC
	help
	  Select this option to enable audio (AC97) on the
	  NUC700/NUC900 demoboards.
```
